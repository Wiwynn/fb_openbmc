## conf/distro/openbmc-pin-dunfell.inc
```bitbake
PREFERRED_VERSION_python3-mypy = "0.910"
PREFERRED_VERSION_python3-mypy-extensions = "0.4.3"
```

## conf/distro/openbmc-yocto-master.inc
```bitbake
# recipes-connectivity/dhcp doesn't exist anymore on master but older
# branches need the bbappend for compatibility.
BBMASK:append = " dhcp.*\.bbappend"
# recipes-utils/flashrom/flashrom_1.2 is needed for both dunfell and kirkstone.
BBMASK:append = " flashrom/flashrom_1.2\.bbappend"
# The linux-aspeed_5.% only exists for non-LF systems; this probably wasn't
# a great way to handle these patches anyhow... They should likely be moved
# to the recipe.
BBMASK:append:openbmc-fb-lf = " acd_0.2/linux-aspeed_5\.%\.bbappend"
# QEMU, which is used for ptest, doesn't have the meta-aspeed either.
BBMASK:append:qemuall = " linux/linux-aspeed_%.bbappend"
BBMASK:append:qemuall = " acd_0.2/linux-aspeed_5\.%\.bbappend"
```

## meta-facebook/conf/distro/openbmc-fb-dunfell.conf
```bitbake
DISTRO_CODENAME="dunfell"
UNPACKDIR ??= "${WORKDIR}"
TCLIBCAPPEND = ""
require conf/distro/include/fb-openbmc.inc
```

## meta-facebook/conf/distro/openbmc-fb-rocko.conf
```bitbake
DISTRO_CODENAME="rocko"
BB_SIGNATURE_HANDLER ?= "OEBasicHash"
UNPACKDIR ??= "${WORKDIR}"
TCLIBCAPPEND = ""
require conf/distro/include/fb-openbmc.inc
```

## meta-facebook/meta-wedge/conf/machine/wedge.conf
```bitbake
#@TYPE: Machine
#@NAME: Wedge
#@DESCRIPTION: Machine configuration for Facebook Wedge

UBOOT_MACHINE_wedge = "wedge_config"

require conf/machine/include/ast1250.inc

# configuration for preferred version of packages  
PREFERRED_VERSION_libipmi = "0.1"
```

## meta-facebook/meta-wedge100/conf/local.conf.sample
```bitbake
#
# Local configuration file for building the OpenBMC image.
#

# Machine Selection
MACHINE ??= "wedge100"

# U-Boot Selection
PREFERRED_VERSION_u-boot = "v2013.07"
PREFERRED_VERSION_u-boot-mkimage = "v2013.07"
PREFERRED_VERSION_u-boot-fw-utils = "v2013.07"

# OpenBMC distro settings
DISTRO ?= "openbmc-fb"
```

## meta-facebook/meta-wedge100/conf/machine/wedge100.conf
```bitbake
#@TYPE: Machine
#@NAME: Wedge
#@DESCRIPTION: Machine configuration for Facebook Wedge

UBOOT_MACHINE_wedge100 = "wedge100_config"

require conf/machine/include/ast1250.inc
```

## meta-facebook/meta-yosemite4-n/conf/machine/yosemite4-n.conf
```bitbake
KMACHINE = "nuvoton"
KERNEL_DEVICETREE = "nuvoton/${KMACHINE}-npcm845-evb.dtb"

UBOOT_MACHINE = "ArbelEVB_defconfig"
UBOOT_DEVICETREE = "nuvoton-npcm845-evb"

IGPS_MACHINE = "EB"
DEVICE_GEN = "A1"

require conf/machine/include/npcm8xx.inc
require conf/machine/include/obmc-bsp-common.inc
require conf/machine/include/facebook-compute-multihost.inc
require conf/machine/include/facebook-tpm2.inc

FLASH_SIZE = "65536"
FLASH_UBOOT_OFFSET:flash-65536 = "0"
FLASH_UBOOT_ENV_OFFSET:flash-65536 = "3840"
FLASH_KERNEL_OFFSET:flash-65536 = "4096"
FLASH_ROFS_OFFSET:flash-65536 = "12288"
FLASH_RWFS_OFFSET:flash-65536 = "61440"

OBMC_HOST_INSTANCES = "1 2 3 4 5 6 7 8"
# Primary chassis as Sled plus secondary chassis in N slots.
OBMC_CHASSIS_INSTANCES = "0 ${OBMC_HOST_INSTANCES}"

VIRTUAL-RUNTIME_obmc-host-state-manager = "phosphor-state-manager-host"
VIRTUAL-RUNTIME_obmc-chassis-state-manager = "phosphor-state-manager-chassis"
```

## meta-facebook/meta-yosemite4/meta-yosemite4-n/conf/machine/yosemite4-n.conf
```bitbake
KMACHINE = "nuvoton"
KERNEL_DEVICETREE = "nuvoton/${KMACHINE}-npcm845-yosemite4.dtb"

UBOOT_MACHINE = "ArbelEVB_defconfig"
UBOOT_DEVICETREE = "nuvoton-npcm845-evb"

IGPS_MACHINE = "EB"
DEVICE_GEN = "A1"

ARCH_DEFAULT_KERNELIMAGETYPE:npcm8xx = "Image"

require meta-yosemite4/conf/machine/include/yosemite4-common.inc
require conf/machine/include/npcm8xx.inc

FLASH_UBOOT_OFFSET:flash-131072 = "0"
FLASH_MANIFEST_OFFSET:flash-131072 = "3072"
FLASH_UBOOT_ENV_OFFSET:flash-131072 = "3840"
FLASH_KERNEL_OFFSET:flash-131072 = "4096"
FLASH_ROFS_OFFSET:flash-131072 = "12288"
FLASH_RWFS_OFFSET:flash-131072 = "61440"

SECURED_IMAGE = "False"
TIP_IMAGE = "False"

DISTRO_VERSION = "yosemite4-n-v2024.05.01"
EXTENDED_VERSION = "${DISTRO_VERSION}"
```
